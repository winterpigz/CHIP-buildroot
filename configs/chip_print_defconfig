## configs/chip_print_defconfig
```kconfig
BR2_arm=y
BR2_cortex_a8=y
BR2_ARM_EABIHF=y
BR2_BACKUP_SITE="http://sources.buildroot.net/"
BR2_KERNEL_MIRROR="http://www.kernel.org/pub/"
BR2_LUAROCKS_MIRROR="http://luarocks.org/repositories/rocks"
BR2_CPAN_MIRROR="http://search.cpan.org/CPAN"
BR2_OPTIMIZE_2=y
BR2_PACKAGE_OVERRIDE_FILE="$(TOPDIR)/local.mk"
BR2_TOOLCHAIN_EXTERNAL=y
BR2_ENABLE_LOCALE_PURGE=y
BR2_ENABLE_LOCALE_WHITELIST="C en_US"
BR2_TARGET_OPTIMIZATION="-pipe"
BR2_TARGET_GENERIC_HOSTNAME="printers"
BR2_TARGET_GENERIC_ISSUE="Welcome to printer server"
BR2_ROOTFS_DEVICE_CREATION_DYNAMIC_MDEV=y
BR2_TARGET_GENERIC_ROOT_PASSWD="Ylwtsmt0"
BR2_TARGET_GENERIC_GETTY_BAUDRATE_115200=y
BR2_TARGET_TZ_INFO=y
BR2_ROOTFS_USERS_TABLES="board/nextthing/chip/users_table.txt"
BR2_ROOTFS_OVERLAY="board/nextthing/chip/overlay"
BR2_ROOTFS_POST_BUILD_SCRIPT="board/nextthing/chip/post-build.sh"
BR2_LINUX_KERNEL=y
BR2_LINUX_KERNEL_CUSTOM_GIT=y
BR2_LINUX_KERNEL_CUSTOM_REPO_URL="https://github.com/NextThingCo/CHIP-linux.git"
BR2_LINUX_KERNEL_CUSTOM_REPO_VERSION="debian/4.4.11-ntc-1"
BR2_LINUX_KERNEL_PATCH="wext_priv.patch"
BR2_LINUX_KERNEL_USE_CUSTOM_CONFIG=y
BR2_LINUX_KERNEL_CUSTOM_CONFIG_FILE="board/nextthing/chip/linux.config"
BR2_LINUX_KERNEL_ZIMAGE=y
BR2_LINUX_KERNEL_DTS_SUPPORT=y
BR2_LINUX_KERNEL_INTREE_DTS_NAME="sun5i-r8-chip"
BR2_LINUX_KERNEL_INSTALL_TARGET=y
BR2_PACKAGE_BUSYBOX_SHOW_OTHERS=y
BR2_PACKAGE_HWTEST=y
BR2_PACKAGE_GZIP=y
BR2_PACKAGE_MMC_UTILS=y
BR2_PACKAGE_MTD=y
BR2_PACKAGE_MTD_MKFSUBIFS=y
BR2_PACKAGE_NTFS_3G=y
BR2_PACKAGE_DEJAVU=y
BR2_PACKAGE_LSUIO=y
BR2_PACKAGE_PCIUTILS=y
BR2_PACKAGE_PYTHON3=y
BR2_PACKAGE_PYTHON3_BZIP2=y
BR2_PACKAGE_PYTHON3_DECIMAL=y
BR2_PACKAGE_PYTHON3_READLINE=y
BR2_PACKAGE_PYTHON3_SSL=y
BR2_PACKAGE_PYTHON3_PYEXPAT=y
BR2_PACKAGE_PYTHON3_ZLIB=y
BR2_PACKAGE_ALSA_LIB=y
BR2_PACKAGE_LIBSNDFILE=y
BR2_PACKAGE_GNUTLS=y
BR2_PACKAGE_LIBGLIB2=y
BR2_PACKAGE_NCURSES_TARGET_PANEL=y
BR2_PACKAGE_NCURSES_TARGET_FORM=y
BR2_PACKAGE_NCURSES_TARGET_MENU=y
BR2_PACKAGE_AVAHI=y
BR2_PACKAGE_AVAHI_DAEMON=y
BR2_PACKAGE_CUPS=y
BR2_PACKAGE_GUTENPRINT=y
BR2_PACKAGE_HPLIP=y
BR2_PACKAGE_IPERF3=y
BR2_PACKAGE_IPROUTE2=y
BR2_PACKAGE_IPTABLES=y
BR2_PACKAGE_NTP=y
# BR2_PACKAGE_NTP_NTPD is not set
BR2_PACKAGE_NTP_NTPDATE=y
BR2_PACKAGE_OPENSSH=y
BR2_PACKAGE_RTL8723BS_BT=y
BR2_PACKAGE_RTL8723BS_BT_CUSTOM_GIT=y
BR2_PACKAGE_RTL8723BS_BT_CUSTOM_REPO_URL="https://github.com/lwfinger/rtl8723bs_bt.git"
BR2_PACKAGE_RTL8723BS_BT_CUSTOM_REPO_VERSION="master"
BR2_PACKAGE_RTL8723BS_MP_DRIVER=y
BR2_PACKAGE_RTL8723BS_MP_DRIVER_CUSTOM_GIT=y
BR2_PACKAGE_RTL8723BS_MP_DRIVER_CUSTOM_REPO_URL="https://github.com/NextThingCo/RTL8723BS.git"
BR2_PACKAGE_RTL8723BS_MP_DRIVER_CUSTOM_REPO_VERSION="master"
BR2_PACKAGE_TCPDUMP=y
BR2_PACKAGE_WGET=y
BR2_PACKAGE_WPA_SUPPLICANT=y
BR2_PACKAGE_WPA_SUPPLICANT_AP_SUPPORT=y
BR2_PACKAGE_WPA_SUPPLICANT_EAP=y
BR2_PACKAGE_WPA_SUPPLICANT_HOTSPOT=y
BR2_PACKAGE_WPA_SUPPLICANT_DEBUG_SYSLOG=y
BR2_PACKAGE_WPA_SUPPLICANT_CLI=y
BR2_PACKAGE_WPA_SUPPLICANT_PASSPHRASE=y
BR2_PACKAGE_BASH=y
BR2_PACKAGE_SCREEN=y
BR2_PACKAGE_SUDO=y
BR2_PACKAGE_KMOD=y
BR2_PACKAGE_KMOD_TOOLS=y
BR2_PACKAGE_UTIL_LINUX_LIBBLKID=y
BR2_TARGET_ROOTFS_CPIO=y
BR2_TARGET_ROOTFS_UBIFS=y
BR2_TARGET_ROOTFS_UBIFS_LEBSIZE=0x1f8000
BR2_TARGET_ROOTFS_UBIFS_MINIOSIZE=0x4000
BR2_TARGET_ROOTFS_UBIFS_MAXLEBCNT=2000
BR2_TARGET_ROOTFS_UBIFS_LZO=y
BR2_TARGET_ROOTFS_UBI=y
BR2_TARGET_ROOTFS_UBI_PEBSIZE=0x200000
BR2_TARGET_ROOTFS_UBI_SUBSIZE=16384
BR2_TARGET_UBOOT=y
BR2_TARGET_UBOOT_BOARDNAME="CHIP"
BR2_TARGET_UBOOT_CUSTOM_GIT=y
BR2_TARGET_UBOOT_CUSTOM_REPO_URL="https://github.com/NextThingCo/CHIP-u-boot.git"
BR2_TARGET_UBOOT_CUSTOM_REPO_VERSION="nextthing/chip-production-v1.2"
BR2_TARGET_UBOOT_FORMAT_CUSTOM=y
BR2_TARGET_UBOOT_FORMAT_CUSTOM_NAME="u-boot-dtb.bin"
BR2_TARGET_UBOOT_SPL=y
BR2_TARGET_UBOOT_SPL_NAME="spl/sunxi-spl.bin spl/sunxi-spl-with-ecc.bin"
BR2_TARGET_UBOOT_ENVIMAGE=y
BR2_TARGET_UBOOT_ENVIMAGE_SOURCE="board/nextthing/chip/uboot-env"
BR2_TARGET_UBOOT_ENVIMAGE_SIZE="0x400000"
BR2_PACKAGE_HOST_DTC_OVERLAY=y
BR2_PACKAGE_HOST_SUNXI_TOOLS=y
```
